## Kconfig
```kconfig
menu "Presidio Hardened ESP32"

    config PRESIDIO_SECURITY_ENABLE
        bool "Enable Presidio security hardening"
        default y
        help
            Master switch for all Presidio security extensions.
            When enabled, presidio_security_init() applies hardened defaults.

    config PRESIDIO_TLS_HARDENING
        bool "Harden mbedTLS configuration"
        default y
        depends on PRESIDIO_SECURITY_ENABLE
        help
            Enforce TLS 1.2 minimum with strong cipher suites only.
            Disables RC4, DES, 3DES, MD5, and other weak algorithms.

    config PRESIDIO_TLS_MIN_VERSION_13
        bool "Require TLS 1.3 minimum"
        default n
        depends on PRESIDIO_TLS_HARDENING
        help
            Enforce TLS 1.3 as the minimum protocol version.
            Some servers may not support TLS 1.3; leave disabled for TLS 1.2+.

    config PRESIDIO_NVS_REDACTION
        bool "Enable NVS secret redaction in logs"
        default y
        depends on PRESIDIO_SECURITY_ENABLE
        help
            Automatically redact secret values when logging NVS operations.
            Keys matching patterns like "password", "key", "token", "secret"
            will have their values replaced with "***REDACTED***" in logs.

    config PRESIDIO_NVS_ENCRYPTION
        bool "Enable NVS encryption helpers"
        default y
        depends on PRESIDIO_SECURITY_ENABLE
        help
            Provide helpers for NVS encrypted partition initialization.

    config PRESIDIO_BOOT_ENFORCEMENT
        bool "Enforce secure boot and flash encryption checks"
        default y
        depends on PRESIDIO_SECURITY_ENABLE
        help
            Log warnings when secure boot or flash encryption are not enabled.
            In production builds, optionally halt boot if security fuses are unset.

    config PRESIDIO_BOOT_HALT_IF_INSECURE
        bool "Halt boot if secure boot is disabled (production)"
        default n
        depends on PRESIDIO_BOOT_ENFORCEMENT
        help
            Abort initialization if secure boot fuses are not burned.
            Only enable this for final production firmware.

    config PRESIDIO_ANOMALY_DETECTION
        bool "Enable runtime anomaly detection"
        default y
        depends on PRESIDIO_SECURITY_ENABLE
        help
            Monitor system events for security anomalies such as repeated
            authentication failures, unexpected reboots, and OTA tampering.

    config PRESIDIO_ANOMALY_MAX_AUTH_FAILURES
        int "Max authentication failures before alert"
        default 5
        depends on PRESIDIO_ANOMALY_DETECTION
        range 1 100
        help
            Number of consecutive authentication failures that triggers
            a security alert event.

    config PRESIDIO_INPUT_SANITIZATION
        bool "Enable input sanitization"
        default y
        depends on PRESIDIO_SECURITY_ENABLE
        help
            Provide input sanitization for Wi-Fi credentials, MQTT topics,
            HTTP bodies, and other common attack vectors.

    config PRESIDIO_INPUT_MAX_WIFI_SSID_LEN
        int "Maximum Wi-Fi SSID length"
        default 32
        depends on PRESIDIO_INPUT_SANITIZATION
        range 1 32

    config PRESIDIO_INPUT_MAX_WIFI_PASS_LEN
        int "Maximum Wi-Fi password length"
        default 64
        depends on PRESIDIO_INPUT_SANITIZATION
        range 8 64

    config PRESIDIO_INPUT_MAX_MQTT_TOPIC_LEN
        int "Maximum MQTT topic length"
        default 256
        depends on PRESIDIO_INPUT_SANITIZATION
        range 1 1024

    config PRESIDIO_INPUT_MAX_HTTP_BODY_LEN
        int "Maximum HTTP body length for sanitization"
        default 4096
        depends on PRESIDIO_INPUT_SANITIZATION
        range 64 65536

    config PRESIDIO_SECURITY_LOG
        bool "Enable security event logging"
        default y
        depends on PRESIDIO_SECURITY_ENABLE
        help
            Log structured security events with timestamps and severity levels.

    config PRESIDIO_LOG_MAX_EVENTS
        int "Security event ring buffer size"
        default 64
        depends on PRESIDIO_SECURITY_LOG
        range 8 1024
        help
            Number of security events to retain in the ring buffer.

endmenu
```

## test_app/sdkconfig.defaults
```kconfig
# Enable all Presidio features for testing
CONFIG_PRESIDIO_SECURITY_ENABLE=y
CONFIG_PRESIDIO_TLS_HARDENING=y
CONFIG_PRESIDIO_NVS_REDACTION=y
CONFIG_PRESIDIO_NVS_ENCRYPTION=y
CONFIG_PRESIDIO_BOOT_ENFORCEMENT=y
CONFIG_PRESIDIO_ANOMALY_DETECTION=y
CONFIG_PRESIDIO_INPUT_SANITIZATION=y
CONFIG_PRESIDIO_SECURITY_LOG=y
CONFIG_PRESIDIO_LOG_MAX_EVENTS=64

# Partition table with NVS
CONFIG_PARTITION_TABLE_SINGLE_APP=y

# mbedTLS settings for testing
CONFIG_MBEDTLS_SSL_PROTO_TLS1_2=y
CONFIG_MBEDTLS_KEY_EXCHANGE_ECDHE=y
CONFIG_MBEDTLS_AES_C=y
CONFIG_MBEDTLS_GCM_C=y
```
